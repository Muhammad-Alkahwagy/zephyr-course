## app/Kconfig
```kconfig
menuconfig LED_SUBSYSTEM
    bool "LED Subsystem"
    default y
    help
      Enable the LED subsystem.

if LED_SUBSYSTEM

choice
    prompt "LED blink speed"
    default BLINK_SPEED_1000MS

config BLINK_SPEED_250MS
    bool "Fast (250 ms)"

config BLINK_SPEED_1000MS
    bool "Medium (1 s)"

config BLINK_SPEED_2000MS
    bool "Slow (2 s)"

endchoice

config BLINK_SLEEP_TIME_MS
    int #no prompt
    default 250 if BLINK_SPEED_250MS
    default 1000 if BLINK_SPEED_1000MS
    default 2000 if BLINK_SPEED_2000MS
    default 0

    help
        --time between led toggles in milliseconds--

menuconfig LED_ADVANCED
    bool "Advanced LED settings"
    default n

if LED_ADVANCED

config LED_BRIGHTNESS
    int "LED brightness (0-100)"
    default 100
    range 0 100

config LED_FADE_DURATION
    int "LED fade duration (ms)"
    default 500

menu "Expert settings"
    visible if LED_ADVANCED

config LED_DEBUG
    bool "Enable LED debugging"
    default n

config LED_CUSTOM_BLINK
    bool "Custom blink pattern"
    default n

endmenu

endif # LED_ADVANCED
endif # LED_SUBSYSTEM



# config BLINK_SLEEP_TIME_MS
#     int "LED blink interval(ms)"
#     default 1000
#     range 100 5000
#     help
#         --time between led toggles in milliseconds--


source "Kconfig.zephyr"
```

## west.yml
```yaml
manifest:
  version: 1.0

  projects:
    - name: zephyr
      url: https://github.com/zephyrproject-rtos/zephyr
      revision: v4.4.0
      import:
        name-allowlist:
          - hal_stm32
          - hal_espressif
        path-prefix: deps
```
